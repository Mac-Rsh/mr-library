## bsp/wch/driver/serial/Kconfig
```kconfig
menu "Uart driver configure"
    # Use Serial
    if MR_USE_SERIAL
        # UART1
        config MR_USE_UART1
            bool "Use uart1 driver"
            default n
    
        menu "UART1 driver configure"
            depends on MR_USE_UART1
    
            config MR_CFG_UART1_GROUP
                int "Uart1 group"
                default 1
                range 1 4

            config MR_USE_UART1_DMA
                bool "Use uart1 dma"
                default n
        endmenu
    
        # UART2
        config MR_USE_UART2
            bool "Use uart2 driver"
            default n
    
        menu "UART2 driver configure"
            depends on MR_USE_UART2
    
            config MR_CFG_UART2_GROUP
                int "Uart2 group"
                default 1
                range 1 2

            config MR_USE_UART2_DMA
                bool "Use uart2 dma"
                default n
        endmenu
    
        # UART3
        config MR_USE_UART3
            bool "Use uart3 driver"
            default n
    
        menu "UART3 driver configure"
            depends on MR_USE_UART3
    
            config MR_CFG_UART3_GROUP
                int "Uart3 group"
                default 1
                range 1 4

            config MR_USE_UART3_DMA
                bool "Use uart3 dma"
                default n
        endmenu
    
        # UART4
        config MR_USE_UART4
            bool "Use uart4 driver"
            default n
    
        menu "UART4 driver configure"
            depends on MR_USE_UART4
    
            config MR_CFG_UART4_GROUP
                int "Uart4 group"
                default 1
                range 1 3

            config MR_USE_UART4_DMA
                bool "Use uart4 dma"
                default n
        endmenu
    
        # UART5
        config MR_USE_UART5
            bool "Use uart5 driver"
            default n
    
        menu "UART5 driver configure"
            depends on MR_USE_UART5
    
            config MR_CFG_UART5_GROUP
                int "Uart5 group"
                default 1
                range 1 3

            config MR_USE_UART5_DMA
                bool "Use uart5 dma"
                default n
        endmenu
    
        # UART6
        config MR_USE_UART6
            bool "Use uart6 driver"
            default n
    
        menu "UART6 driver configure"
            depends on MR_USE_UART6
    
            config MR_CFG_UART6_GROUP
                int "Uart6 group"
                default 1
                range 1 3

            config MR_USE_UART6_DMA
                bool "Use uart6 dma"
                default n
        endmenu
    
        # UART7
        config MR_USE_UART7
            bool "Use uart7 driver"
            default n
    
        menu "UART7 driver configure"
            depends on MR_USE_UART7
    
            config MR_CFG_UART7_GROUP
                int "Uart7 group"
                default 1
                range 1 3

            config MR_USE_UART7_DMA
                bool "Use uart7 dma"
                default n
        endmenu
    
        # UART8
        config MR_USE_UART8
            bool "Use uart8 driver"
            default n
    
        menu "UART8 driver configure"
            depends on MR_USE_UART8
    
            config MR_CFG_UART8_GROUP
                int "Uart8 group"
                default 1
                range 1 3

            config MR_USE_UART8_DMA
                bool "Use uart8 dma"
                default n
        endmenu
    endif

    # Unused serial prompt
    if !MR_USE_SERIAL
        comment "Please enable serial device first"
    endif
endmenu
```

## components/msh/Kconfig
```kconfig
config MR_USING_MSH
    bool "Use msh component"
    default n
    help
        "Use this option allows for the use of the shell."
menu "Msh configure"
    depends on MR_USING_MSH

    config MR_CFG_MSH_BUFSZ
        int "Msh buffer size"
        default 32
        range 16 1024
        help
            "This option sets the buffer size used by the shell."

    config MR_CFG_MSH_ARGS_NUM
        int "Msh argument max number"
        default 16
        range 4 64
        help
            "This option sets the max number of arguments."

    config MR_CFG_MSH_HISTORY_LINES
        int "Msh history max lines"
        default 4
        range 1 64
        help
            "This option sets the max number of history lines."

    config MR_CFG_MSH_DEV_NAME
        string "Msh device name"
        default "serial1"
        help
            "This option sets the name of the device used by the shell."

    config MR_CFG_MSH_NONBLOCKING
        bool "Use msh non-blocking"
        default n
        help
            "Use this option allows for the use of the shell non-blocking."

    config MR_CFG_MSH_PRINTF_BUFSZ
        int "Printf buffer size"
        default 128
        range 32 2147483647
        help
            "This option sets the buffer size used by the printf function."

    config MR_CFG_MSH_PROMPT
        string "Msh prompt"
        default "msh"
        help
            "This option sets the prompt of the shell."

    config MR_USING_MSH_PRINTF_COLOR
        bool "Use msh printf color"
        default n
        help
            "This option allows for the use of the printf color in the msh."

    config MR_USING_MSH_ECHO
        bool "Use msh echo"
        default y
        help
            "Use this option allows for the use of the echo in the msh."

    config MR_USING_MSH_DEV_CMD
        bool "Use msh device cmd"
        default y
        help
            "Use this option allows for the use of the device cmd in the msh."

    config MR_USING_
endmenu
```

## device/Kconfig
```kconfig
menu "Device configure"

    # Name
    config MR_CFG_DEVICE_NAME_MAX
        int "Device name max length"
        range 4 1024
        default 12
        help
            This option sets the max length of the device name.

    # Descriptors
    config MR_CFG_DESCRIPTOR_MAX
        int "Descriptors max number"
        range 8 4096
        default 128
        help
            This option sets the max number of descriptors.

    comment "--- Device ---"

    # ADC
    source "device/adc/Kconfig"

    # PIN
    source "device/pin/Kconfig"

    # PWM
    source "device/pwm/Kconfig"

    # Serial
    source "device/serial/Kconfig"

    # SPI
    source "device/spi/Kconfig"

    # Timer
    source "device/timer/Kconfig"

endmenu
```

## device/adc/Kconfig
```kconfig
menu "ADC configure"

    # ADC
    config MR_USE_ADC
        bool "Use ADC"
        default n
        help
            Use this option allows for the use of ADC.

    config MR_USE_ADC_CHECK
        depends on MR_USE_ADC
        bool "Use ADC check"
        default y
        help
            This option allows for the use of ADC check.

endmenu
```

## device/pin/Kconfig
```kconfig
menu "Pin configure"

    # Pin
    config MR_USE_PIN
        bool "Use pin"
        default n
        help
            Use this option allows for the use of pin.

    config MR_USE_PIN_CHECK
        depends on MR_USE_PIN
        bool "Use pin check"
        default y
        help
            This option allows for the use of pin check.

endmenu
```

## device/pwm/Kconfig
```kconfig
menu "PWM configure"

    # PWM
    config MR_USE_PWM
        bool "Use PWM"
        default n
        help
            Use this option allows for the use of PWM.

    config MR_USE_PWM_CHECK
        bool "Use PWM check"
        default y
        help
            This option allows for the use of PWM check.

endmenu
```

## device/serial/Kconfig
```kconfig
menu "Serial configure"

    # Serial
    config MR_USE_SERIAL
        bool "Use serial"
        default n
        help
            Use this option allows for the use of serial.

    config MR_CFG_SERIAL_RD_FIFO_SIZE
        depends on MR_USE_SERIAL
        int "Serial read fifo size"
        range 0 2147483647
        default 128
        help
            This option sets the size of the read FIFO.

    config MR_CFG_SERIAL_WR_FIFO_SIZE
        depends on MR_USE_SERIAL
        int "Serial write fifo size"
        range 0 2147483647
        default 0
        help
            This option sets the size of the write FIFO.

    # DMA
    config MR_USE_SERIAL_DMA
        depends on MR_USE_SERIAL
        bool "Use serial dma"
        default n
        help
            Use this option allows for the use of serial DMA.

    config MR_CFG_SERIAL_RD_DMA_FIFO_SIZE
        depends on MR_USE_SERIAL_DMA
        int "Serial read dma fifo size"
        range 0 2147483647
        default 128
        help
            This option sets the size of the read DMA FIFO.

    config MR_CFG_SERIAL_WR_DMA_FIFO_SIZE
        depends on MR_USE_SERIAL_DMA
        int "Serial write dma fifo size"
        range 0 2147483647
        default 128
        help
            This option sets the size of the write DMA FIFO.

    # AIO
    config MR_USE_SERIAL_AIO_EXT
        depends on MR_USE_SERIAL and MR_USE_AIO_EXT
        bool "Use serial extended AIO"
        default n
        help
            This option uses extended asynchronous I/O

endmenu
```

## device/spi/Kconfig
```kconfig
menu "SPI configure"

    # SPI
    config MR_USE_SPI
        bool "Use SPI"
        default n
        help
            Use this option allows for the use of SPI.

    config MR_CFG_SPI_RD_FIFO_SIZE
        depends on MR_USE_SPI
        int "SPI read FIFO size"
        range 0 2147483647
        default 128
        help
            This option sets the size of the read FIFO.

    config MR_CFG_SPI_WR_FIFO_SIZE
        depends on MR_USE_SPI
        int "SPI write FIFO size"
        range 0 2147483647
        default 0
        help
            This option sets the size of the write FIFO.

endmenu
```

## device/timer/Kconfig
```kconfig
menu "Timer configure"

    # Timer
    config MR_USE_TIMER
        bool "Use timer"
        default n
        help
            Use this option allows for the use of timer.

endmenu
```

## source/Kconfig
```kconfig
menu "System configure"
    # Heap
    config MR_CFG_HEAP_SIZE
        int "Heap size (bytes)"
        default 4096
        range 32 2147483647
        help
            This option sets the size of the heap used by the library.

endmenu
```
