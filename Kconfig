## bsp/st/driver/Kconfig
```kconfig
menu "Board configure"

    choice
        prompt "Chip type"
        default MR_USING_STM32F1

        config MR_USING_STM32F0
            bool "STM32F0"

        config MR_USING_STM32F1
            bool "STM32F1"

        config MR_USING_STM32F2
            bool "STM32F2"

        config MR_USING_STM32F3
            bool "STM32F3"

        config MR_USING_STM32F4
            bool "STM32F4"

        config MR_USING_STM32F7
            bool "STM32F7"

        config MR_USING_STM32G0
            bool "STM32G0"

        config MR_USING_STM32G4
            bool "STM32G4"

        config MR_USING_STM32H5
            bool "STM32H5"

        config MR_USING_STM32H7
            bool "STM32H7"

        config MR_USING_STM32L0
            bool "STM32L0"

        config MR_USING_STM32L1
            bool "STM32L1"

        config MR_USING_STM32L4
            bool "STM32L4"

        config MR_USING_STM32L5
            bool "STM32L5"
    endchoice

    menu "ADC"
        config MR_USING_ADC1
            bool "Enable ADC1 driver"
            default n

        config MR_USING_ADC2
            bool "Enable ADC2 driver"
            default n

        config MR_USING_ADC3
            bool "Enable ADC3 driver"
            default n
    endmenu

    menu "GPIO"
        config MR_USING_GPIOA
            bool "Enable GPIOA driver"
            default n

        config MR_USING_GPIOB
            bool "Enable GPIOB driver"
            default n

        config MR_USING_GPIOC
            bool "Enable GPIOC driver"
            default n

        config MR_USING_GPIOD
            bool "Enable GPIOD driver"
            default n

        config MR_USING_GPIOE
            bool "Enable GPIOE driver"
            default n
    endmenu

    menu "UART"
        config MR_USING_UART1
            bool "Enable UART1 driver"
            default n

        config MR_USING_UART2
            bool "Enable UART2 driver"
            default n

        config MR_USING_UART3
            bool "Enable UART3 driver"
            default n

        config MR_USING_UART4
            bool "Enable UART4 driver"
            default n

        config MR_USING_UART5
            bool "Enable UART5 driver"
            default n

        config MR_USING_UART6
            bool "Enable UART6 driver"
            default n

        config MR_USING_UART7
            bool "Enable UART7 driver"
            default n

        config MR_USING_UART8
            bool "Enable UART8 driver"
            default n
    endmenu

    menu "SPI"
        config MR_USING_SPI1
            bool "Enable SPI1 driver"
            default n

        config MR_USING_SPI2
            bool "Enable SPI2 driver"
            default n

        config MR_USING_SPI3
            bool "Enable SPI3 driver"
            default n

        config MR_USING_SPI4
            bool "Enable SPI3 driver"
            default n

        config MR_USING_SPI5
            bool "Enable SPI5 driver"
            default n

        config MR_USING_SPI6
            bool "Enable SPI6 driver"
            default n
    endmenu

    menu "Timer"
        config MR_USING_TIMER1
            bool "Enable Timer1 driver"
            default n

        config MR_USING_TIMER2
            bool "Enable Timer2 driver"
            default n

        config MR_USING_TIMER3
            bool "Enable Timer3 driver"
            default n

        config MR_USING_TIMER4
            bool "Enable Timer4 driver"
            default n

        config MR_USING_TIMER5
            bool "Enable Timer5 driver"
            default n

        config MR_USING_TIMER6
            bool "Enable Timer6 driver"
            default n

        config MR_USING_TIMER7
            bool "Enable Timer7 driver"
            default n

        config MR_USING_TIMER8
            bool "Enable Timer8 driver"
            default n

        config MR_USING_TIMER9
            bool "Enable Timer9 driver"
            default n

        config MR_USING_TIMER10
            bool "Enable Timer10 driver"
            default n

        config MR_USING_TIMER11
            bool "Enable Timer11 driver"
            default n

        config MR_USING_TIMER12
            bool "Enable Timer12 driver"
            default n

        config MR_USING_TIMER13
            bool "Enable Timer13 driver"
            default n

        config MR_USING_TIMER14
            bool "Enable Timer14 driver"
            default n
    endmenu

endmenu
```

## bsp/st/stm32f407/driver/Kconfig
```kconfig
menu "Driver configure"

    menu "ADC"
        config MR_USING_ADC1
            bool "Enable ADC1 driver"
            default n

        config MR_USING_ADC2
            bool "Enable ADC2 driver"
            default n

        config MR_USING_ADC3
            bool "Enable ADC3 driver"
            default n
    endmenu

    menu "DAC"
        config MR_USING_DAC1
            bool "Enable DAC1 driver"
            default n
    endmenu

    menu "PWM"
        config MR_USING_PWM1
            bool "Enable PWM1 driver"
            default n

        config MR_USING_PWM2
            bool "Enable PWM2 driver"
            default n

        config MR_USING_PWM3
            bool "Enable PWM3 driver"
            default n

        config MR_USING_PWM4
            bool "Enable PWM4 driver"
            default n

        config MR_USING_PWM5
            bool "Enable PWM5 driver"
            default n

        config MR_USING_PWM6
            bool "Enable PWM6 driver"
            default n

        config MR_USING_PWM7
            bool "Enable PWM7 driver"
            default n

        config MR_USING_PWM8
            bool "Enable PWM8 driver"
            default n

        config MR_USING_PWM9
            bool "Enable PWM9 driver"
            default n

        config MR_USING_PWM10
            bool "Enable PWM10 driver"
            default n

        config MR_USING_PWM11
            bool "Enable PWM11 driver"
            default n

        config MR_USING_PWM12
            bool "Enable PWM12 driver"
            default n

        config MR_USING_PWM13
            bool "Enable PWM13 driver"
            default n

        config MR_USING_PWM14
            bool "Enable PWM14 driver"
            default n
    endmenu

    menu "UART"
        config MR_USING_UART1
            bool "Enable UART1 driver"
            default n

        config MR_USING_UART2
            bool "Enable UART2 driver"
            default n

        config MR_USING_UART3
            bool "Enable UART3 driver"
            default n

        config MR_USING_UART4
            bool "Enable UART4 driver"
            default n

        config MR_USING_UART5
            bool "Enable UART5 driver"
            default n

        config MR_USING_UART6
            bool "Enable UART6 driver"
            default n
    endmenu

    menu "SPI"
        config MR_USING_SPI1
            bool "Enable SPI1 driver"
            default n

        config MR_USING_SPI2
            bool "Enable SPI2 driver"
            default n

        config MR_USING_SPI3
            bool "Enable SPI3 driver"
            default n
    endmenu

    menu "Timer"
        config MR_USING_TIMER1
            bool "Enable Timer1 driver"
            default n

        config MR_USING_TIMER2
            bool "Enable Timer2 driver"
            default n

        config MR_USING_TIMER3
            bool "Enable Timer3 driver"
            default n

        config MR_USING_TIMER4
            bool "Enable Timer4 driver"
            default n

        config MR_USING_TIMER5
            bool "Enable Timer5 driver"
            default n

        config MR_USING_TIMER6
            bool "Enable Timer6 driver"
            default n

        config MR_USING_TIMER7
            bool "Enable Timer7 driver"
            default n

        config MR_USING_TIMER8
            bool "Enable Timer8 driver"
            default n

        config MR_USING_TIMER9
            bool "Enable Timer9 driver"
            default n

        config MR_USING_TIMER10
            bool "Enable Timer10 driver"
            default n

        config MR_USING_TIMER11
            bool "Enable Timer11 driver"
            default n

        config MR_USING_TIMER12
            bool "Enable Timer12 driver"
            default n

        config MR_USING_TIMER13
            bool "Enable Timer13 driver"
            default n

        config MR_USING_TIMER14
            bool "Enable Timer14 driver"
            default n
    endmenu

endmenu
```

## bsp/st/stm32f411/driver/Kconfig
```kconfig
menu "Driver configure"

    menu "ADC"
        config MR_USING_ADC1
            bool "Enable ADC1 driver"
            default n
    endmenu

    menu "PWM"
        config MR_USING_PWM1
            bool "Enable PWM1 driver"
            default n

        config MR_USING_PWM2
            bool "Enable PWM2 driver"
            default n

        config MR_USING_PWM3
            bool "Enable PWM3 driver"
            default n

        config MR_USING_PWM4
            bool "Enable PWM4 driver"
            default n

        config MR_USING_PWM5
            bool "Enable PWM5 driver"
            default n

        config MR_USING_PWM9
            bool "Enable PWM9 driver"
            default n

        config MR_USING_PWM10
            bool "Enable PWM10 driver"
            default n

        config MR_USING_PWM11
            bool "Enable PWM11 driver"
            default n
    endmenu

    menu "UART"
        config MR_USING_UART1
            bool "Enable UART1 driver"
            default n

        config MR_USING_UART2
            bool "Enable UART2 driver"
            default n

        config MR_USING_UART6
            bool "Enable UART6 driver"
            default n
    endmenu

    menu "SPI"
        config MR_USING_SPI1
            bool "Enable SPI1 driver"
            default n

        config MR_USING_SPI2
            bool "Enable SPI2 driver"
            default n

        config MR_USING_SPI3
            bool "Enable SPI3 driver"
            default n

        config MR_USING_SPI4
            bool "Enable SPI3 driver"
            default n

        config MR_USING_SPI5
            bool "Enable SPI5 driver"
            default n
    endmenu

    menu "Timer"
        config MR_USING_TIMER1
            bool "Enable Timer1 driver"
            default n

        config MR_USING_TIMER2
            bool "Enable Timer2 driver"
            default n

        config MR_USING_TIMER3
            bool "Enable Timer3 driver"
            default n

        config MR_USING_TIMER4
            bool "Enable Timer4 driver"
            default n

        config MR_USING_TIMER5
            bool "Enable Timer5 driver"
            default n

        config MR_USING_TIMER9
            bool "Enable Timer9 driver"
            default n

        config MR_USING_TIMER10
            bool "Enable Timer10 driver"
            default n

        config MR_USING_TIMER11
            bool "Enable Timer11 driver"
            default n
    endmenu

endmenu
```

## bsp/wch/ch32v003/driver/Kconfig
```kconfig
menu "Driver configure"

    config MR_USING_CH32V00X
        bool "Enable CH32V00X driver"
        default y

    menu "ADC"
        config MR_USING_ADC1
            bool "Enable ADC1 driver"
            default n
    endmenu

    menu "I2C"
        config MR_USING_I2C1
            bool "Enable I2C1 driver"
            default n

        menu "I2C1 driver configure"
            depends on MR_USING_I2C1

            config MR_CFG_I2C1_GROUP
                int "I2C1 Group"
                default 1
                range 1 3
        endmenu
    endmenu

    menu "UART"
        config MR_USING_UART1
            bool "Enable UART1 driver"
            default n

        menu "UART1 driver configure"
            depends on MR_USING_UART1

            config MR_CFG_UART1_GROUP
                int "UART1 Group"
                default 1
                range 1 4
        endmenu
    endmenu

    menu "SPI"
        config MR_USING_SPI1
            bool "Enable SPI1 driver"
            default n
    endmenu

    menu "Timer"
        config MR_USING_TIMER1
            bool "Enable Timer1 driver"
            default n

        config MR_USING_TIMER2
            bool "Enable Timer2 driver"
            default n
    endmenu

endmenu
```
