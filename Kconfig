## bsp/wch/ch32v203/driver/Kconfig
```kconfig
menu "Driver configure"

    menu "ADC"
        config MR_USING_ADC1
            bool "Enable ADC1 driver"
            default n

        config MR_USING_ADC2
            bool "Enable ADC2 driver"
            default n
    endmenu

    menu "I2C"
        config MR_USING_I2C1
            bool "Enable I2C1 driver"
            default n

        menu "I2C1 driver configure"
            depends on MR_USING_I2C1

            config MR_CFG_I2C1_GROUP
                int "I2C1 Group"
                default 1
                range 1 2
        endmenu

        config MR_USING_I2C2
            bool "Enable I2C2 driver"
            default n

        menu "I2C2 driver configure"
            depends on MR_USING_I2C2

            config MR_CFG_I2C2_GROUP
                int "I2C2 Group"
                default 1
                range 1 1
        endmenu
    endmenu

    menu "PWM"
        config MR_USING_PWM1
            bool "Enable PWM1 driver"
            default n

        menu "PWM1 driver configure"
            depends on MR_USING_PWM1

            config MR_CFG_PWM1_GROUP
                int "PWM1 Group"
                default 1
                range 1 1
        endmenu

        config MR_USING_PWM2
            bool "Enable PWM2 driver"
            default n

        menu "PWM2 driver configure"
            depends on MR_USING_PWM2

            config MR_CFG_PWM2_GROUP
                int "PWM2 Group"
                default 1
                range 1 4
        endmenu

        config MR_USING_PWM3
            bool "Enable PWM3 driver"
            default n

        menu "PWM3 driver configure"
            depends on MR_USING_PWM3

            config MR_CFG_PWM3_GROUP
                int "PWM3 Group"
                default 1
                range 1 3
        endmenu

        config MR_USING_PWM4
            bool "Enable PWM4 driver"
            default n

        menu "PWM4 driver configure"
            depends on MR_USING_PWM4

            config MR_CFG_PWM4_GROUP
                int "PWM4 Group"
                default 1
                range 1 1
        endmenu

        config MR_USING_PWM5
            bool "Enable PWM5 driver"
            default n

        menu "PWM5 driver configure"
            depends on MR_USING_PWM5

            config MR_CFG_PWM5_GROUP
                int "PWM5 Group"
                default 1
                range 1 1
        endmenu
    endmenu

    menu "UART"
        config MR_USING_UART1
            bool "Enable UART1 driver"
            default n

        menu "UART1 driver configure"
            depends on MR_USING_UART1

            config MR_CFG_UART1_GROUP
                int "UART1 Group"
                default 1
                range 1 2
        endmenu

        config MR_USING_UART2
            bool "Enable UART2 driver"
            default n

        menu "UART2 driver configure"
            depends on MR_USING_UART2

            config MR_CFG_UART2_GROUP
                int "UART2 Group"
                default 1
                range 1 1
        endmenu

        config MR_USING_UART3
            bool "Enable UART3 driver"
            default n

        menu "UART3 driver configure"
            depends on MR_USING_UART3

            config MR_CFG_UART3_GROUP
                int "UART3 Group"
                default 1
                range 1 2
        endmenu

        config MR_USING_UART4
            bool "Enable UART4 driver"
            default n

        menu "UART4 driver configure"
            depends on MR_USING_UART4

            config MR_CFG_UART4_GROUP
                int "UART4 Group"
                default 1
                range 1 2
        endmenu
    endmenu

    menu "SPI"
        config MR_USING_SPI1
            bool "Enable SPI1 driver"
            default n

        menu "SPI1 driver configure"
            depends on MR_USING_SPI1

            config MR_CFG_SPI1_GROUP
                int "SPI1 Group"
                default 1
                range 1 2
        endmenu

        config MR_USING_SPI2
            bool "Enable SPI2 driver"
            default n

        menu "SPI2 driver configure"
            depends on MR_USING_SPI2

            config MR_CFG_SPI2_GROUP
                int "SPI2 Group"
                default 1
                range 1 1
        endmenu
    endmenu

    menu "Timer"
        config MR_USING_TIMER1
                    bool "Enable Timer1 driver"
                    default n

        config MR_USING_TIMER2
                        bool "Enable Timer2 driver"
                        default n

        config MR_USING_TIMER3
                    bool "Enable Timer3 driver"
                    default n

        config MR_USING_TIMER4
                    bool "Enable Timer4 driver"
                    default n

        config MR_USING_TIMER5
                    bool "Enable Timer5 driver"
                    default n
    endmenu

endmenu
```

## bsp/wch/ch32v307/driver/Kconfig
```kconfig
menu "Driver configure"

    # ADC
    source "driver/adc/Kconfig"

    # Serial
    source "driver/serial/Kconfig"
endmenu
```

## bsp/wch/ch32v307/driver/serial/Kconfig
```kconfig
menu "Serial driver configure"
    # Use Serial
    if MR_USE_SERIAL
        # SERIAL1
        config MR_USE_SERIAL1
            bool "Use serial1 driver"
            default n
    
        menu "Serial1 driver configure"
            depends on MR_USE_SERIAL1
    
            config MR_CFG_SERIAL1_GROUP
                int "Serial1 group"
                default 1
                range 1 4

            config MR_USE_SERIAL1_DMA
                depends on MR_USE_SERIAL_DMA
                bool "Use serial1 dma"
                default y
        endmenu
    
        # SERIAL2
        config MR_USE_SERIAL2
            bool "Use serial2 driver"
            default n
    
        menu "Serial2 driver configure"
            depends on MR_USE_SERIAL2
    
            config MR_CFG_SERIAL2_GROUP
                int "Serial2 group"
                default 1
                range 1 2

            config MR_USE_SERIAL2_DMA
                depends on MR_USE_SERIAL_DMA
                bool "Use serial2 dma"
                default y
        endmenu
    
        # SERIAL3
        config MR_USE_SERIAL3
            bool "Use serial3 driver"
            default n
    
        menu "Serial3 driver configure"
            depends on MR_USE_SERIAL3
    
            config MR_CFG_SERIAL3_GROUP
                int "Serial3 group"
                default 1
                range 1 4

            config MR_USE_SERIAL3_DMA
                depends on MR_USE_SERIAL_DMA
                bool "Use serial3 dma"
                default y
        endmenu
    
        # SERIAL4
        config MR_USE_SERIAL4
            bool "Use serial4 driver"
            default n
    
        menu "Serial4 driver configure"
            depends on MR_USE_SERIAL4
    
            config MR_CFG_SERIAL4_GROUP
                int "Serial4 group"
                default 1
                range 1 3

            config MR_USE_SERIAL4_DMA
                depends on MR_USE_SERIAL_DMA
                bool "Use serial4 dma"
                default y
        endmenu
    
        # SERIAL5
        config MR_USE_SERIAL5
            bool "Use serial5 driver"
            default n
    
        menu "Serial5 driver configure"
            depends on MR_USE_SERIAL5
    
            config MR_CFG_SERIAL5_GROUP
                int "Serial5 group"
                default 1
                range 1 3

            config MR_USE_SERIAL5_DMA
                depends on MR_USE_SERIAL_DMA
                bool "Use serial5 dma"
                default y
        endmenu
    
        # SERIAL6
        config MR_USE_SERIAL6
            bool "Use serial6 driver"
            default n
    
        menu "Serial6 driver configure"
            depends on MR_USE_SERIAL6
    
            config MR_CFG_SERIAL6_GROUP
                int "Serial6 group"
                default 1
                range 1 3

            config MR_USE_SERIAL6_DMA
                depends on MR_USE_SERIAL_DMA
                bool "Use serial6 dma"
                default y
        endmenu
    
        # SERIAL7
        config MR_USE_SERIAL7
            bool "Use serial7 driver"
            default n
    
        menu "Serial7 driver configure"
            depends on MR_USE_SERIAL7
    
            config MR_CFG_SERIAL7_GROUP
                int "Serial7 group"
                default 1
                range 1 3

            config MR_USE_SERIAL7_DMA
                depends on MR_USE_SERIAL_DMA
                bool "Use serial7 dma"
                default y
        endmenu
    
        # SERIAL8
        config MR_USE_SERIAL8
            bool "Use serial8 driver"
            default n
    
        menu "Serial8 driver configure"
            depends on MR_USE_SERIAL8
    
            config MR_CFG_SERIAL8_GROUP
                int "Serial8 group"
                default 1
                range 1 3

            config MR_USE_SERIAL8_DMA
                depends on MR_USE_SERIAL_DMA
                bool "Use serial8 dma"
                default y
        endmenu
    endif

    # Unused serial prompt
    if !MR_USE_SERIAL
        comment "Please enable serial device first"
    endif
endmenu
```

## bsp/wch/ch32v30x/driver/Kconfig
```kconfig
menu "Board configure"

    menu "ADC"

        config MR_USING_ADC1
            bool "Enable ADC1 driver"
            default n

        config MR_USING_ADC2
            bool "Enable ADC2 driver"
            default n

    endmenu

    menu "DAC"

        config MR_USING_DAC1
            bool "Enable DAC1 driver"
            default n

    endmenu

    menu "I2C"

        config MR_USING_I2C1
            bool "Enable I2C1 driver"
            default n

        menu "I2C1 driver configure"
            depends on MR_USING_I2C1

            config MR_CFG_I2C1_GROUP
                int "I2C1 Group"
                default 1
                range 1 2
        endmenu

        config MR_USING_I2C2
            bool "Enable I2C2 driver"
            default n

        menu "I2C2 driver configure"
            depends on MR_USING_I2C2

            config MR_CFG_I2C2_GROUP
                int "I2C2 Group"
                default 1
                range 1 1
        endmenu

    endmenu

    menu "GPIO"

        config MR_USING_GPIOA
            bool "Enable GPIOA driver"
            default n

        config MR_USING_GPIOB
            bool "Enable GPIOB driver"
            default n

        config MR_USING_GPIOC
            bool "Enable GPIOC driver"
            default n

        config MR_USING_GPIOD
            bool "Enable GPIOD driver"
            default n

        config MR_USING_GPIOE
            bool "Enable GPIOE driver"
            default n

    endmenu

    menu "UART"

        config MR_USING_UART1
            bool "Enable UART1 driver"
            default n

        menu "UART1 driver configure"
            depends on MR_USING_UART1

            config MR_CFG_UART1_GROUP
                int "UART1 Group"
                default 1
                range 1 4
        endmenu

        config MR_USING_UART2
            bool "Enable UART2 driver"
            default n

        menu "UART2 driver configure"
            depends on MR_USING_UART2

            config MR_CFG_UART2_GROUP
                int "UART2 Group"
                default 1
                range 1 2
        endmenu

        config MR_USING_UART3
            bool "Enable UART3 driver"
            default n

        menu "UART3 driver configure"
            depends on MR_USING_UART3

            config MR_CFG_UART3_GROUP
                int "UART3 Group"
                default 1
                range 1 4
        endmenu

        config MR_USING_UART4
            bool "Enable UART4 driver"
            default n

        menu "UART4 driver configure"
            depends on MR_USING_UART4

            config MR_CFG_UART4_GROUP
                int "UART4 Group"
                default 1
                range 1 3
        endmenu

        config MR_USING_UART5
            bool "Enable UART5 driver"
            default n

        menu "UART5 driver configure"
            depends on MR_USING_UART5

            config MR_CFG_UART5_GROUP
                int "UART5 Group"
                default 1
                range 1 3
        endmenu

        config MR_USING_UART6
            bool "Enable UART6 driver"
            default n

        menu "UART6 driver configure"
            depends on MR_USING_UART6

            config MR_CFG_UART6_GROUP
                int "UART6 Group"
                default 1
                range 1 3
        endmenu

        config MR_USING_UART7
            bool "Enable UART7 driver"
            default n

        menu "UART7 driver configure"
            depends on MR_USING_UART7

            config MR_CFG_UART7_GROUP
                int "UART7 Group"
                default 1
                range 1 3
        endmenu

        config MR_USING_UART8
            bool "Enable UART8 driver"
            default n

        menu "UART8 driver configure"
            depends on MR_USING_UART8

            config MR_CFG_UART8_GROUP
                int "UART8 Group"
                default 1
                range 1 3
        endmenu

    endmenu

    menu "SPI"

        config MR_USING_SPI1
            bool "Enable SPI1 driver"
            default n

        menu "SPI1 driver configure"
            depends on MR_USING_SPI1

            config MR_CFG_SPI1_GROUP
                int "SPI1 Group"
                default 1
                range 1 2
        endmenu

        config MR_USING_SPI2
            bool "Enable SPI2 driver"
            default n

        menu "SPI2 driver configure"
            depends on MR_USING_SPI2

            config MR_CFG_SPI2_GROUP
                int "SPI2 Group"
                default 1
                range 1 1
        endmenu

        config MR_USING_SPI3
        bool "Enable SPI3 driver"
        default n

        menu "SPI3 driver configure"
            depends on MR_USING_SPI3

            config MR_CFG_SPI3_GROUP
                int "SPI3 Group"
                default 1
                range 1 2
        endmenu

    endmenu

endmenu
```

## bsp/wch/driver/Kconfig
```kconfig
menu "Driver configure"
    # Replace driver prompt
    comment "Please use the driver of the corresponding model to replace the driver"
endmenu
```

## bsp/wch/driver/adc/Kconfig
```kconfig
menu "Adc driver configure"
    # Use ADC
    if MR_USE_ADC
        # ADC1
        config MR_USE_ADC1
            bool "Use adc1 driver"
            default n
    
        # ADC2
        config MR_USE_ADC2
            bool "Use adc2 driver"
            default n
    endif

    # Unused adc prompt
    if !MR_USE_ADC
        comment "Please enable adc device first"
    endif
endmenu
```
